## conf/layer.conf
```bitbake
# We have a conf and classes directory, add to BBPATH
BBPATH .= ":${LAYERDIR}"

# We have a recipes-* directories, add to BBFILES
BBFILES += "${LAYERDIR}/recipes-*/*/*.bb \
	${LAYERDIR}/recipes-*/*/*.bbappend"

BBFILE_COLLECTIONS += "qemuarm-bsp"
BBFILE_PATTERN_qemuarm-bsp = "^${LAYERDIR}/"
BBFILE_PRIORITY_qemuarm-bsp = "6"
```

## conf/machine/include/qemuarm-bsp.inc
```bitbake
#@TYPE: Machine
#@NAME: Qemuarm-bsp common config

#@DESCRIPTION: Common machine configuration for qemu simulation

PREFERRED_PROVIDER_virtual/egl ?= "mesa"
PREFERRED_PROVIDER_virtual/libgl ?= "mesa"
PREFERRED_PROVIDER_virtual/libgles1 ?= "mesa"
PREFERRED_PROVIDER_virtual/libgles2 ?= "mesa"

MACHINE_EXTRA_RRECOMMENDS = " kernel-modules kernel-devicetree"

EXTRA_IMAGEDEPENDS += "u-boot qemu-native qemu-helper-native"

#TODO add ext4
IMAGE_FSTYPES += "tar.bz2"

SERIAL_CONSOLE = "115200 ttyAMA0"

KERNEL_IMAGETYPE = "uImage"
KERNEL_EXTRA_ARGS += "LOADADDR=${UBOOT_ENTRYPOINT}"

UBOOT_SUFFIX = "bin"
UBOOT_ENTRYPOINT = "0x80008000"
UBOOT_LOADADDRESS = "0x80008000"

PREFERRED_PROVIDER_virtual/kernel ?= "linux-stable"
PREFERRED_PROVIDER_virtual/bootloader ?= "u-boot"

PREFERRED_VERSION_linux-custom = "v4.0.4"

MACHINE_FEATURES = " \
    usbgadget \
    usbhost \
    keyboard \
    vfat \
    ext2 \
    alsa \
    bluetooth \
    wifi \
    sdio \
    screen \
    "

IMAGE_BOOT_FILES ?= "u-boot.${UBOOT_SUFFIX}"
```

## conf/machine/qemuarmv7.conf
```bitbake
#@TYPE: Machine
#@NAME: qemuarmv7

#@DESCRIPTION: Machine configuration for qemuarm-bsp systems

require conf/machine/include/tune-cortexa7.inc
include conf/machine/include/qemuarm-bsp.inc

KERNEL_DEVICETREE = " "

# TODO right config file
UBOOT_MACHINE = "qemu_armv7_defconfig"
```
